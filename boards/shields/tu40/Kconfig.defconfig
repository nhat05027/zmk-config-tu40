## boards/shields/tu40/Kconfig.defconfig
```kconfig
if SHIELD_TU40

# Name must be less than 16 characters long!
config ZMK_KEYBOARD_NAME
    default "tu40"

endif
```

## boards/shields/tu40/Kconfig.shield
```kconfig
# No whitespace after the comma or in your keyboard name!
config SHIELD_TU40
    def_bool $(shields_list_contains,tu40)
```

## boards/shields/tu40/boards/nice_nano.conf
```kconfig
# Uncomment the following lines to enable RGB Underglow
CONFIG_ZMK_RGB_UNDERGLOW=y
CONFIG_WS2812_STRIP=y
```
